## conf/layer.conf
```bitbake
BBPATH .= ":${LAYERDIR}"

# the first line is where the layer recipe is found
# the second line is where the image recipe is found
BBFILES += " \
    ${LAYERDIR}/recipes-core/*/*.bb \
    ${LAYERDIR}/recipes-core/images/*.bb \
    "

# register the layer within BitBake's layer collection
BBFILE_COLLECTION += "meta-hello-world"

# tell BitBake the root dir to search for this layer's recipes
BBFILE_PATTERN_meta-hello-world = "^${LAYERDIR}/"

# layer dependencies (only needs core, separate with a space if more needed)
LAYERDEPENDS_meta-hello-world = "core"

# the git branch/yocto release this layer is compatible with
LAYERSERIES_COMPAT_meta-hello-world = "scarthgap"
```
